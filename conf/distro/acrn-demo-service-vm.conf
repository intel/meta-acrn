## conf/distro/acrn-demo-service-vm.conf
```bitbake
require conf/distro/include/acrn-demo.inc

DISTRO .= "-service-vm"
DISTRO_NAME += "(Service VM)"
DISTRO_FEATURES += "ServiceVM"

PREFERRED_PROVIDER_virtual/kernel ?= "linux-intel-acrn-service-vm"
PREFERRED_VERSION_linux-intel-acrn-service-vm ?= "5.15%"

# elementpath 4.0.1 has removed 'SYMBOLS' attribute, which causing failure in ACRN 3.1.0
# https://github.com/sissaschool/elementpath/commit/a76aeb88b0d103420239df1d5d001f7d7f56b5c9
#
# misc/config_tools/scenario_config/elementpath_overlay.py", line 24, in CustomParser
#|     SYMBOLS = BaseParser.SYMBOLS | {
#|               ^^^^^^^^^^^^^^^^^^
#| AttributeError: type object 'XPath2Parser' has no attribute 'SYMBOLS'
# Carry python3-elementpath 3.0.2 version locally, until it gets fixed upstream
PREFERRED_VERSION_python3-elementpath = "3.0.2"
PREFERRED_VERSION_python3-elementpath-native = "3.0.2"

# Newer version throw TypeError:
# build_schema_node_tree() got an unexpected keyword argument 'uri'
PREFERRED_VERSION_python3-xmlschema = "3.0.1"
PREFERRED_VERSION_python3-xmlschema-native = "3.0.1"


# ACRN hypervisor log setting, sensible defaults
LINUX_ACRN_APPEND ?= "hvlog=2M@0xE00000 ${@bb.utils.contains('EFI_PROVIDER','grub-efi','memmap=2M\$0xE00000','memmap=2M$0xE00000',d)} "
# GVT enabling. Service VM has pipe 0, one UOS has the rest.
LINUX_GVT_APPEND ?= "i915.enable_gvt=1 i915.nuclear_pageflip=1 "

APPEND += "${LINUX_ACRN_APPEND} ${LINUX_GVT_APPEND}"

EFI_PROVIDER = "grub-efi"
GRUB_BUILDIN:append = " multiboot2 "
WKS_FILE = "${@bb.utils.contains_any("IMAGE_CLASSES", "dm-verity-img", "acrn-bootdisk-dmverity.wks.in", "acrn-bootdisk-microcode.wks.in", d)}"

# Disable auto ethernet DHCP as its handled by ACRN tools
PACKAGECONFIG:remove:pn-systemd-conf = "dhcp-ethernet"
```

## conf/distro/acrn-demo-sos.conf
```bitbake
require conf/distro/include/acrn-demo.inc

DISTRO .= "-sos"
DISTRO_NAME += "(SOS)"
DISTRO_FEATURES += "SOS"

PREFERRED_PROVIDER_virtual/kernel ?= "linux-intel-acrn-sos"
PREFERRED_VERSION_linux-intel-acrn-sos ?= "5.10%"

PREFERRED_PROVIDER_libvirt = "acrn-libvirt"
PREFERRED_PROVIDER_libvirt-native = "acrn-libvirt-native"
PREFERRED_PROVIDER_nativesdk-libvirt = "nativesdk-acrn-libvirt"

# acrn-libvirt (v6.1.0) is not supported by python3-docutil v0.17 and higher
# python3-docutils (v0.16) recipe from this layer should be dropped with
# acrn-libvirt upgrade
PREFERRED_VERSION_python3-docutils = "0.16"
PREFERRED_VERSION_python3-docutils-native = "0.16"

# GVT enabling. SOS has pipe 0, one UOS has the rest.
LINUX_GVT_APPEND ?= "i915.enable_gvt=1 i915.nuclear_pageflip=1 "

APPEND += " ${LINUX_GVT_APPEND}"

EFI_PROVIDER = "grub-efi"
GRUB_BUILDIN:append = " multiboot2 "
WKS_FILE = "${@bb.utils.contains_any("IMAGE_CLASSES", "dm-verity-img", "acrn-bootdisk-dmverity.wks.in", "acrn-bootdisk-microcode.wks.in", d)}"

# Disable auto ethernet DHCP as its handled by ACRN tools
PACKAGECONFIG:remove:pn-systemd-conf = "dhcp-ethernet"
```

## conf/distro/acrn-demo-uos-rt.conf
```bitbake
require conf/distro/include/acrn-demo.inc

DISTRO .= "-uos"
DISTRO_NAME += "(UOS)"

PREFERRED_PROVIDER_virtual/kernel ?= "linux-intel-rt-acrn-uos"

# UOS images are always ext4
IMAGE_FSTYPES = "wic ext4"

# Ensure images typically include networkd-config so that networking is
# configured.
MACHINE_ESSENTIAL_EXTRA_RRECOMMENDS += "networkd-config"

APPEND += " clocksource=tsc tsc=reliable x2apic_phys processor.max_cstate=0 intel_idle.max_cstate=0 intel_pstate=disable mce=ignore_ce audit=0 isolcpus=nohz,domain,1 nohz_full=1 rcu_nocbs=1 nosoftlockup idle=poll irqaffinity=0"
```

## conf/distro/acrn-demo-uos.conf
```bitbake
require conf/distro/include/acrn-demo.inc

DISTRO .= "-uos"
DISTRO_NAME += "(UOS)"

PREFERRED_PROVIDER_virtual/kernel ?= "linux-intel-acrn-uos"
PREFERRED_VERSION_linux-intel-acrn-uos ?= "5.10%"
PREFERRED_VERSION_linux-intel-rt-acrn-uos ?= "5.10%"

# UOS images are always ext4
IMAGE_FSTYPES = "wic ext4"

# Ensure images typically include networkd-config so that networking is
# configured.
MACHINE_ESSENTIAL_EXTRA_RRECOMMENDS += "networkd-config"

LINUX_RT_APPEND ?= "${@bb.utils.contains_any('PREFERRED_PROVIDER_virtual/kernel', 'linux-intel-rt-acrn-uos linux-intel-ese-lts-rt-acrn-uos', 'clocksource=tsc tsc=reliable x2apic_phys processor.max_cstate=0 intel_idle.max_cstate=0 intel_pstate=disable mce=ignore_ce audit=0 isolcpus=nohz,domain,1 nohz_full=1 rcu_nocbs=1 nosoftlockup idle=poll irqaffinity=0 no_ipi_broadcast=1', '', d)}"
APPEND += " rw nohpet console=hvc0 console=ttyS0 no_timer_check ignore_loglevel log_buf_len=16M consoleblank=0 tsc=reliable \
            i915.nuclear_pageflip=1 ${LINUX_RT_APPEND}"
```

## conf/distro/acrn-demo-user-vm.conf
```bitbake
require conf/distro/include/acrn-demo.inc

DISTRO .= "-user-vm"
DISTRO_NAME += "(User VM)"

PREFERRED_PROVIDER_virtual/kernel ?= "linux-intel-acrn-user-vm"
PREFERRED_VERSION_linux-intel-acrn-user-vm ?= "5.15%"
PREFERRED_VERSION_linux-intel-acrn-rtvm ?= "5.15%"

# User VM images are always ext4
IMAGE_FSTYPES = "wic ext4"

# Ensure images typically include networkd-config so that networking is
# configured.
MACHINE_ESSENTIAL_EXTRA_RRECOMMENDS += "networkd-config"

LINUX_RT_APPEND ?= "${@bb.utils.contains_any('PREFERRED_PROVIDER_virtual/kernel', 'linux-intel-acrn-rtvm', 'clocksource=tsc tsc=reliable x2apic_phys processor.max_cstate=0 intel_idle.max_cstate=0 intel_pstate=disable mce=ignore_ce audit=0 isolcpus=nohz,domain,1 nohz_full=1 rcu_nocbs=1 nosoftlockup idle=poll irqaffinity=0 no_ipi_broadcast=1', '', d)}"
APPEND += " rw nohpet console=hvc0 console=ttyS0 no_timer_check ignore_loglevel log_buf_len=16M consoleblank=0 tsc=reliable \
            i915.nuclear_pageflip=1 ${LINUX_RT_APPEND}"
```

## conf/distro/include/acrn-demo.inc
```bitbake
DISTRO = "acrn-demo"
DISTRO_NAME = "ACRN Demo"
DISTRO_VERSION = "4.0+snapshot-${DATE}"

DISTRO_FEATURES = "${DISTRO_FEATURES_DEFAULT} \
                   systemd efi largefile opengl ptest multiarch \
                   wayland vulkan pulseaudio bluez5 gobject-introspection-data"

VIRTUAL-RUNTIME_init_manager = "systemd"
DISTRO_FEATURES_BACKFILL_CONSIDERED = "sysvinit"

WARN_TO_ERROR_QA = "already-stripped compile-host-path install-host-path \
                    installed-vs-shipped ldflags pn-overrides rpaths staticdev \
                    unknown-configure-option useless-rpaths"
WARN_QA:remove = "${WARN_TO_ERROR_QA}"
ERROR_QA:append = " ${WARN_TO_ERROR_QA}"

require conf/distro/include/no-static-libs.inc
require conf/distro/include/yocto-uninative.inc
require conf/distro/include/security_flags.inc
INHERIT += "uninative"

TCLIBCAPPEND = ""

# Set the Sato network manager to be systemd, instead of connman.
# The Service VM needs to use networkd to get the bridges working correctly, and
# networkd makes guest networking trivial.
NETWORK_MANAGER = "systemd"
```

## conf/layer.conf
```bitbake
BBPATH .= ":${LAYERDIR}"

BBFILES += "${LAYERDIR}/recipes-*/*/*.bb \
            ${LAYERDIR}/recipes-*/*/*.bbappend"

BBFILE_COLLECTIONS += "meta-acrn"
BBFILE_PATTERN_meta-acrn = "^${LAYERDIR}/"
BBFILE_PRIORITY_meta-acrn = "5"

LAYERDEPENDS_meta-acrn = "core intel meta-python"
LAYERSERIES_COMPAT_meta-acrn = "kirkstone langdale mickledore"

BBFILES_DYNAMIC += " \
    virtualization-layer:${LAYERDIR}/dynamic-layers/virtualization-layer/*/*/*.bb \
    virtualization-layer:${LAYERDIR}/dynamic-layers/virtualization-layer/*/*/*.bbappend \
"
LAYERDIR-acrn := "${LAYERDIR}"
```
